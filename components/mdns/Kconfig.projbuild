## components/mdns/Kconfig.projbuild
```kconfig
menu "MDNS Configuration"

config MDNS_HOSTNAME
    string "mDNS Hostname"
	default "kt"
	help
		mDNS Hostname for example to use

config MDNS_INSTANCE
    string "mDNS Instance Name"
	default "ESP8266 Host"
	help
		mDNS Instance Name for example to use

endmenu
```

## components/wifi/Kconfig.projbuild
```kconfig
menu "Wifi Configuration"


config WIFI_SSID
    string "WiFi SSID"
	default "DANIELA_UPC"
	help
		SSID (network name) for the example to connect to.

config WIFI_PASSWORD
    string "WiFi Password"
	default "Kt0566331208"
	help
		WiFi password (WPA or WPA2) for the example to use.
```
